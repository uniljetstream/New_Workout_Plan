## esp_idf_project/main/Kconfig.projbuild
```kconfig
menu "Workout MQTT 설정"

config WORKOUT_MQTT_ENABLED
    bool "워크아웃 MQTT 사용"
    default y

if WORKOUT_MQTT_ENABLED

config WORKOUT_MQTT_BROKER_URI
    string "MQTT 브로커 URI"
    default "mqtt://10.10.16.111:1883"
    help
        MQTT 브로커 주소를 입력하세요. 예: mqtt://example.com:1883 또는 mqtts://example.com:8883

config WORKOUT_MQTT_CLIENT_ID
    string "MQTT 클라이언트 ID"
    default "esp32-heart-rate"

config WORKOUT_MQTT_USERNAME
    string "MQTT 사용자 이름 (토큰)"
    default ""
    help
        API 토큰을 사용자 이름 또는 비밀번호로 요구할 경우 여기에 입력합니다.

config WORKOUT_MQTT_PASSWORD
    string "MQTT 비밀번호"
    default ""

config WORKOUT_MQTT_TOPIC_HEART_RATE
    string "심박수 발행 토픽"
    default "esp32/sensor/data"

config WORKOUT_MQTT_QOS
    int "심박수 메시지 QoS"
    range 0 2
    default 1

config WORKOUT_MQTT_KEEPALIVE_SEC
    int "MQTT Keepalive (초)"
    range 15 600
    default 60

config WORKOUT_MQTT_CERT_PEM
    string "MQTT 브로커 CA 인증서 (PEM)"
    default ""
    help
        TLS 브로커에 접속할 경우 PEM 형식의 CA 인증서를 붙여 넣습니다.

endif # WORKOUT_MQTT_ENABLED

endmenu
```

## exerciser/main/Kconfig.projbuild
```kconfig
menu "Exerciser Configuration"

    config WIFI_SSID
        string "WiFi SSID"
        default "your_wifi_ssid"
        help
            SSID (network name) for the exerciser to connect to.

    config WIFI_PASSWORD
        string "WiFi Password"
        default "your_wifi_password"
        help
            WiFi password (WPA or WPA2) for the exerciser to use.

    config WIFI_MAX_RETRY
        int "Maximum retry"
        default 5
        help
            Set the Maximum retry to avoid station reconnecting to the AP unlimited when the AP is really inexistent.

    config MQTT_BROKER_URL
        string "MQTT Broker URL"
        default "mqtt://10.10.16.111"
        help
            URL of the MQTT broker to connect to (mqtt://hostname or mqtts://hostname).

    config MQTT_TOPIC_COMMAND
        string "MQTT Command Topic"
        default "watchtower/command/joystick"
        help
            MQTT topic for receiving commands from WatchTower (same as joystick).

    config MQTT_TOPIC_STATUS
        string "MQTT Status Topic"
        default "exerciser/status"
        help
            MQTT topic for publishing exerciser status.

endmenu
```

## exerciser/sdkconfig.defaults
```kconfig
# ESP32-C3 Configuration
CONFIG_IDF_TARGET="esp32c3"

# WiFi Configuration
CONFIG_ESP_WIFI_SSID=""
CONFIG_ESP_WIFI_PASSWORD=""

# MQTT Configuration
CONFIG_MQTT_PROTOCOL_311=y

# FreeRTOS
CONFIG_FREERTOS_HZ=1000

# Log level
CONFIG_LOG_DEFAULT_LEVEL_INFO=y

# Enable WiFi
CONFIG_ESP32_WIFI_ENABLED=y
```

## mpu6050_mqtt/main/Kconfig.projbuild
```kconfig
menu "ESP32 MPU6050 MQTT Configuration"

    menu "Wi-Fi Configuration"
        config WIFI_SSID
            string "WiFi SSID"
            default "myssid"
            help
                SSID (network name) for the ESP32 to connect to.

        config WIFI_PASSWORD
            string "WiFi Password"
            default "mypassword"
            help
                WiFi password (WPA or WPA2) for the ESP32 to use.

        config WIFI_MAX_RETRY
            int "Maximum retry"
            default 5
            help
                Set the Maximum retry to avoid station reconnecting to the AP unlimited when the AP is really inexistent.
    endmenu

    menu "MQTT Configuration"
        config MQTT_BROKER_URL
            string "Broker URL"
            default "mqtt://mqtt.eclipseprojects.io:1883"
            help
                URL of the MQTT broker to connect to

        config MQTT_TOPIC_SENSOR_DATA
            string "Sensor Data Topic"
            default "esp32/sensor/data"
            help
                MQTT topic for publishing sensor data

        config MQTT_TOPIC_COMMAND
            string "Command Topic"
            default "esp32/command"
            help
                MQTT topic for receiving commands

        config MQTT_TOPIC_RESPONSE
            string "Response Topic"
            default "esp32/response"
            help
                MQTT topic for publishing responses
    endmenu

    config BROKER_URL_FROM_STDIN
        bool
        default y if MQTT_BROKER_URL = "FROM_STDIN"

endmenu
```

## mpu6050_mqtt_esp32c3/main/Kconfig.projbuild
```kconfig
menu "ESP32 MPU6050 MQTT Configuration"

    menu "Wi-Fi Configuration"
        config WIFI_SSID
            string "WiFi SSID"
            default "myssid"
            help
                SSID (network name) for the ESP32 to connect to.

        config WIFI_PASSWORD
            string "WiFi Password"
            default "mypassword"
            help
                WiFi password (WPA or WPA2) for the ESP32 to use.

        config WIFI_MAX_RETRY
            int "Maximum retry"
            default 5
            help
                Set the Maximum retry to avoid station reconnecting to the AP unlimited when the AP is really inexistent.
    endmenu

    menu "MQTT Configuration"
        config MQTT_BROKER_URL
            string "Broker URL"
            default "mqtt://192.168.1.100:1883"
            help
                URL of the MQTT broker to connect to (WatchTower Jetson)

        config MQTT_TOPIC_SENSOR_DATA
            string "Sensor Data Topic"
            default "joystick/sensor/data"
            help
                MQTT topic for publishing joystick sensor data (WatchTower protocol)

        config MQTT_TOPIC_STATUS
            string "Status Topic"
            default "joystick/status"
            help
                MQTT topic for publishing joystick status

        config MQTT_TOPIC_COMMAND
            string "Command Topic"
            default "watchtower/command/joystick"
            help
                MQTT topic for receiving commands from WatchTower
    endmenu

    config BROKER_URL_FROM_STDIN
        bool
        default y if MQTT_BROKER_URL = "FROM_STDIN"

endmenu
```
